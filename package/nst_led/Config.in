## package/nst_led/Config.in
```kconfig
config BR2_PACKAGE_NST_LED
    bool"nst led"
    help
      nst led light to show
```

## package/nst_led_light/Config.in
```kconfig
config BR2_PACKAGE_NST_LED_LIGHT
    bool"nst led light"
    help
      nst led light so test to show
```
